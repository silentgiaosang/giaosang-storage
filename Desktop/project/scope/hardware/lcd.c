/**
  ******************************************************************************
  * @file    lcd.c
  * @brief   ST7789V TFT LCD 驱动 (240x320, 4线SPI Mode0)
  * @note    跨平台 - 所有硬件配置通过 lcd.h 宏定义, 换MCU只需改.h
  ******************************************************************************
  */
#include "lcd.h"
#include <string.h>
#include <stdio.h>

/* ======================== 6x12 ASCII 字体 (ASCII 0x20-0x7E) ======================== */
static const uint8_t font_6x12[][12] = {
    {0x00,0x00,0x00,0x00,0x00,0x00,0x00,0x00,0x00,0x00,0x00,0x00}, /*   */
    {0x00,0x00,0x20,0x20,0x20,0x20,0x20,0x20,0x00,0x20,0x00,0x00}, /* ! */
    {0x00,0x50,0x50,0x50,0x00,0x00,0x00,0x00,0x00,0x00,0x00,0x00}, /* " */
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    {0x00,0x00,0x00,0x00,0x50,0xA0,0x00,0x00,0x00,0x00,0x00,0x00}, /* ~ */
};

/* ======================== 内部辅助函数 ======================== */

static void LCD_SPI_WriteByte(uint8_t data)
{
    HAL_SPI_Transmit(&LCD_SPI, &data, 1, 10);
}

static void LCD_WriteCmd(uint8_t cmd)
{
    LCD_DC_LOW();
    LCD_CS_LOW();
    LCD_SPI_WriteByte(cmd);
    LCD_CS_HIGH();
}

static void LCD_WriteData(uint8_t data)
{
    LCD_DC_HIGH();
    LCD_CS_LOW();
    LCD_SPI_WriteByte(data);
    LCD_CS_HIGH();
}

static void LCD_WriteData16(uint16_t data)
{
    LCD_DC_HIGH();
    LCD_CS_LOW();
    LCD_SPI_WriteByte(data >> 8);
    LCD_SPI_WriteByte(data & 0xFF);
    LCD_CS_HIGH();
}

static void LCD_WriteColorBurst(uint16_t color, uint32_t count)
{
    uint8_t hi = color >> 8;
    uint8_t lo = color & 0xFF;

    LCD_DC_HIGH();
    LCD_CS_LOW();
    while (count--)
    {
        LCD_SPI_WriteByte(hi);
        LCD_SPI_WriteByte(lo);
    }
    LCD_CS_HIGH();
}

/* ======================== GPIO 初始化 ======================== */

static void LCD_GPIO_Init(void)
{
    GPIO_InitTypeDef GPIO_InitStruct = {0};
    __HAL_RCC_GPIOB_CLK_ENABLE();
    __HAL_RCC_GPIOA_CLK_ENABLE();  /* RST在PA9 */

    GPIO_InitStruct.Pin = LCD_CS_PIN;
    GPIO_InitStruct.Mode = GPIO_MODE_OUTPUT_PP;
    GPIO_InitStruct.Pull = GPIO_NOPULL;
    GPIO_InitStruct.Speed = GPIO_SPEED_FREQ_HIGH;
    HAL_GPIO_Init(LCD_CS_PORT, &GPIO_InitStruct);

    GPIO_InitStruct.Pin = LCD_DC_PIN;
    HAL_GPIO_Init(LCD_DC_PORT, &GPIO_InitStruct);

    GPIO_InitStruct.Pin = LCD_RST_PIN;
    HAL_GPIO_Init(LCD_RST_PORT, &GPIO_InitStruct);

    LCD_CS_HIGH();
    LCD_DC_HIGH();
    LCD_RST_HIGH();
}

/* ======================== 初始化序列 ======================== */

static void LCD_HardwareReset(void)
{
    LCD_RST_HIGH();
    HAL_Delay(10);
    LCD_RST_LOW();
    HAL_Delay(10);
    LCD_RST_HIGH();
    HAL_Delay(120);
}

/**
  * @brief  ST7789V 寄存器初始化序列
  * @note   240x320, RGB565, 无X/Y偏移(ST7789与ST7735S不同)
  */
static void LCD_InitReg(void)
{
    /* ---- 软件复位 ---- */
    LCD_WriteCmd(0x01); // SWRESET
    HAL_Delay(150);

    /* ---- 退出休眠 ---- */
    LCD_WriteCmd(0x11); // SLPOUT
    HAL_Delay(120);

    /* ---- 像素格式: 16bit/pixel (RGB565) ---- */
    LCD_WriteCmd(0x3A); // COLMOD
    LCD_WriteData(0x05);

    /* ---- 内存访问控制: 行/列无交换, 无翻转 ---- */
    LCD_WriteCmd(0x36); // MADCTL
    LCD_WriteData(0x00);

    /* ---- 帧速率控制 ---- */
    LCD_WriteCmd(0xB2); // PORCTRL
    LCD_WriteData(0x0C);
    LCD_WriteData(0x0C);
    LCD_WriteData(0x00);
    LCD_WriteData(0x33);
    LCD_WriteData(0x33);

    /* ---- 门控 ---- */
    LCD_WriteCmd(0xB7); // GCTRL
    LCD_WriteData(0x35);

    /* ---- VCOMS ---- */
    LCD_WriteCmd(0xBB); // VCOMS
    LCD_WriteData(0x19);

    /* ---- LCM控制 ---- */
    LCD_WriteCmd(0xC0); // LCMCTRL
    LCD_WriteData(0x2C);

    /* ---- VDV/VRH使能 ---- */
    LCD_WriteCmd(0xC2); // VDVVRHEN
    LCD_WriteData(0x01);

    /* ---- VRH设置 ---- */
    LCD_WriteCmd(0xC3); // VRHS
    LCD_WriteData(0x12);

    /* ---- VDV设置 ---- */
    LCD_WriteCmd(0xC4); // VDVS
    LCD_WriteData(0x20);

    /* ---- 帧速率控制(正常模式) ---- */
    LCD_WriteCmd(0xC6); // FRCTRL2
    LCD_WriteData(0x0F);

    /* ---- 电源控制1 ---- */
    LCD_WriteCmd(0xD0); // PWCTRL1
    LCD_WriteData(0xA4);
    LCD_WriteData(0xA1);

    /* ---- Gamma正极性(PV) ---- */
    LCD_WriteCmd(0xE0); // PVGAMCTRL
    LCD_WriteData(0xD0);
    LCD_WriteData(0x04);
    LCD_WriteData(0x0D);
    LCD_WriteData(0x11);
    LCD_WriteData(0x13);
    LCD_WriteData(0x2B);
    LCD_WriteData(0x3F);
    LCD_WriteData(0x54);
    LCD_WriteData(0x4C);
    LCD_WriteData(0x18);
    LCD_WriteData(0x0D);
    LCD_WriteData(0x0B);
    LCD_WriteData(0x1F);
    LCD_WriteData(0x23);

    /* ---- Gamma负极性(NV) ---- */
    LCD_WriteCmd(0xE1); // NVGAMCTRL
    LCD_WriteData(0xD0);
    LCD_WriteData(0x04);
    LCD_WriteData(0x0C);
    LCD_WriteData(0x11);
    LCD_WriteData(0x13);
    LCD_WriteData(0x2C);
    LCD_WriteData(0x3F);
    LCD_WriteData(0x44);
    LCD_WriteData(0x51);
    LCD_WriteData(0x2F);
    LCD_WriteData(0x1F);
    LCD_WriteData(0x1F);
    LCD_WriteData(0x20);
    LCD_WriteData(0x23);

    /* ---- 反转开启 ---- */
    LCD_WriteCmd(0x21); // INVON

    /* ---- 正常显示模式 ---- */
    LCD_WriteCmd(0x13); // NORON

    /* ---- 显示开 ---- */
    HAL_Delay(10);
    LCD_WriteCmd(0x29); // DISPON
    HAL_Delay(10);
}

/* ======================== 对外接口函数 ======================== */

void LCD_Init(void)
{
    LCD_GPIO_Init();
    LCD_HardwareReset();
    LCD_InitReg();
    LCD_SetDirection(LCD_DIR_HORIZONTAL);
    LCD_Clear(BLACK);
}

void LCD_SetDirection(uint8_t dir)
{
    LCD_WriteCmd(0x36); // MADCTL
    if (dir == LCD_DIR_HORIZONTAL)
        LCD_WriteData(0x00);
    else
        LCD_WriteData(0xC0);
}

/**
  * @brief  设置显示窗口 (列地址 + 行地址)
  * @note   ST7789V: 无X/Y偏移, 直接使用物理坐标
  */
void LCD_SetWindow(uint16_t x1, uint16_t y1, uint16_t x2, uint16_t y2)
{
    LCD_WriteCmd(0x2A);  /* CASET */
    LCD_WriteData16(x1);
    LCD_WriteData16(x2);

    LCD_WriteCmd(0x2B);  /* RASET */
    LCD_WriteData16(y1);
    LCD_WriteData16(y2);

    LCD_WriteCmd(0x2C);  /* RAMWR */
}

void LCD_Clear(uint16_t color)
{
    uint32_t total = (uint32_t)LCD_WIDTH * LCD_HEIGHT;
    LCD_SetWindow(0, 0, LCD_WIDTH - 1, LCD_HEIGHT - 1);
    LCD_WriteColorBurst(color, total);
}

void LCD_DrawPoint(uint16_t x, uint16_t y, uint16_t color)
{
    if (x >= LCD_WIDTH || y >= LCD_HEIGHT) return;
    LCD_SetWindow(x, y, x, y);
    LCD_WriteData16(color);
}

void LCD_Fill(uint16_t x1, uint16_t y1, uint16_t x2, uint16_t y2, uint16_t color)
{
    uint32_t count;
    if (x1 >= LCD_WIDTH || y1 >= LCD_HEIGHT) return;
    if (x2 >= LCD_WIDTH) x2 = LCD_WIDTH - 1;
    if (y2 >= LCD_HEIGHT) y2 = LCD_HEIGHT - 1;

    count = (uint32_t)(x2 - x1 + 1) * (y2 - y1 + 1);
    LCD_SetWindow(x1, y1, x2, y2);
    LCD_WriteColorBurst(color, count);
}

void LCD_DrawLine(uint16_t x1, uint16_t y1, uint16_t x2, uint16_t y2, uint16_t color)
{
    int16_t dx, dy, sx, sy, err, e2;
    dx = (x2 > x1) ? (x2 - x1) : (x1 - x2);
    dy = (y2 > y1) ? (y2 - y1) : (y1 - y2);
    sx = (x1 < x2) ? 1 : -1;
    sy = (y1 < y2) ? 1 : -1;
    err = dx - dy;

    while (1)
    {
        LCD_DrawPoint(x1, y1, color);
        if (x1 == x2 && y1 == y2) break;
        e2 = err * 2;
        if (e2 > -dy) { err -= dy; x1 += sx; }
        if (e2 <  dx) { err += dx; y1 += sy; }
    }
}

void LCD_DrawRect(uint16_t x1, uint16_t y1, uint16_t x2, uint16_t y2, uint16_t color)
{
    LCD_DrawLine(x1, y1, x2, y1, color);
    LCD_DrawLine(x2, y1, x2, y2, color);
    LCD_DrawLine(x2, y2, x1, y2, color);
    LCD_DrawLine(x1, y2, x1, y1, color);
}

void LCD_DrawCircle(uint16_t cx, uint16_t cy, uint16_t r, uint16_t color)
{
    int16_t x = 0, y = r;
    int16_t d = 3 - 2 * r;
    while (x <= y)
    {
        LCD_DrawPoint(cx + x, cy + y, color);
        LCD_DrawPoint(cx - x, cy + y, color);
        LCD_DrawPoint(cx + x, cy - y, color);
        LCD_DrawPoint(cx - x, cy - y, color);
        LCD_DrawPoint(cx + y, cy + x, color);
        LCD_DrawPoint(cx - y, cy + x, color);
        LCD_DrawPoint(cx + y, cy - x, color);
        LCD_DrawPoint(cx - y, cy - x, color);
        if (d < 0) { d = d + 4 * x + 6; }
        else      { d = d + 4 * (x - y) + 10; y--; }
        x++;
    }
}

void LCD_FillCircle(uint16_t cx, uint16_t cy, uint16_t r, uint16_t color)
{
    int16_t x = 0, y = r;
    int16_t d = 3 - 2 * r;
    while (x <= y)
    {
        LCD_DrawLine(cx - x, cy + y, cx + x, cy + y, color);
        LCD_DrawLine(cx - x, cy - y, cx + x, cy - y, color);
        LCD_DrawLine(cx - y, cy + x, cx + y, cy + x, color);
        LCD_DrawLine(cx - y, cy - x, cx + y, cy - x, color);
        if (d < 0) { d = d + 4 * x + 6; }
        else      { d = d + 4 * (x - y) + 10; y--; }
        x++;
    }
}

void LCD_ShowChar(uint16_t x, uint16_t y, char ch, uint16_t color, uint16_t bg_color)
{
    uint8_t i, j;
    uint8_t temp;
    if (ch < ' ' || ch > '~') return;

    LCD_SetWindow(x, y, x + 5, y + 11);
    LCD_DC_HIGH();
    LCD_CS_LOW();
    for (i = 0; i < 12; i++)
    {
        temp = font_6x12[ch - ' '][i];
        for (j = 0; j < 6; j++)
        {
            if (temp & 0x80)
            {
                LCD_SPI_WriteByte(color >> 8);
                LCD_SPI_WriteByte(color & 0xFF);
            }
            else
            {
                LCD_SPI_WriteByte(bg_color >> 8);
                LCD_SPI_WriteByte(bg_color & 0xFF);
            }
            temp <<= 1;
        }
    }
    LCD_CS_HIGH();
}

void LCD_ShowString(uint16_t x, uint16_t y, const char *str, uint16_t color, uint16_t bg_color)
{
    uint16_t x0 = x;
    while (*str)
    {
        if (*str == '\n')
        {
            y += 12;
            x = x0;
        }
        else
        {
            if (x + 6 > LCD_WIDTH) { x = x0; y += 12; }
            if (y + 12 > LCD_HEIGHT) break;
            LCD_ShowChar(x, y, *str, color, bg_color);
            x += 6;
        }
        str++;
    }
}

void LCD_ShowNum(uint16_t x, uint16_t y, int32_t num, uint8_t len, uint16_t color, uint16_t bg_color)
{
    char buf[12];
    uint8_t i, str_len;
    snprintf(buf, sizeof(buf), "%*ld", len, (long)num);
    str_len = strlen(buf);
    for (i = 0; i < str_len; i++)
        LCD_ShowChar(x + i * 6, y, buf[i], color, bg_color);
}

/* ======================== 测试函数 ======================== */

void LCD_Test(void)
{
    LCD_Fill(0,   0, 47,  39, RED);
    LCD_Fill(48,  0, 95,  39, GREEN);
    LCD_Fill(96,  0, 143, 39, BLUE);
    LCD_Fill(144, 0, 191, 39, YELLOW);
    LCD_Fill(192, 0, 239, 39, MAGENTA);

    for (uint16_t i = 0; i < 240; i++)
    {
        uint8_t r_val = (i < 120) ? (i * 2) : (255 - (i - 120) * 2);
        uint8_t g_val = (i < 120) ? 0 : ((i - 120) * 2);
        uint16_t grad = LCD_RGB565(r_val, g_val, 0);
        LCD_DrawLine(i, 45, i, 59, grad);
    }

    LCD_DrawRect(5,   65, 35,  95, WHITE);
    LCD_Fill(45,  65, 75,  95, CYAN);
    LCD_DrawCircle(90, 80, 15, WHITE);
    LCD_FillCircle(115, 80, 12, BRED);

    LCD_ShowString(2, 102, "STM32F407", GREEN, BLACK);
    LCD_ShowString(2, 114, "ST7789V", YELLOW, BLACK);
    LCD_ShowString(2, 126, "SPI Mode0", CYAN, BLACK);
    LCD_ShowString(2, 138, "240x320", MAGENTA, BLACK);
    LCD_ShowNum(180, 148, 2026, 4, WHITE, BLACK);

    HAL_Delay(3000);

    LCD_Clear(RED);     HAL_Delay(500);
    LCD_Clear(GREEN);   HAL_Delay(500);
    LCD_Clear(BLUE);    HAL_Delay(500);
    LCD_Clear(WHITE);   HAL_Delay(500);
    LCD_Clear(BLACK);   HAL_Delay(500);
}
